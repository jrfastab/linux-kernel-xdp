## net/kproxy/Kconfig
```kconfig
config AF_KPROXY
	tristate "Kernel proxy"
	depends on INET
	select BPF_SYSCALL
	select STREAM_PARSER
	---help---
	  Kernel proxy implements an in kernel TCP proxy for performance.
	  Filtering is done by BPF on incoming sockets.

config KPROXY_DIAG
	tristate "KPROXY: socket monitoring interface"
	depends on AF_KPROXY 
	---help---
	  Support for KPROXY socket monitoring interface.

	  if unsure, say Y.
```
